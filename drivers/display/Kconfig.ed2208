## drivers/display/Kconfig.ed2208
```kconfig
# ED2208 display controller configuration options

# Copyright (c) 2026 Hendrik Timmermann
# SPDX-License-Identifier: Apache-2.0

config ED2208
	bool "Waveshare ED2208 compatible display controller driver"
	default y
	depends on DT_HAS_WAVESHARE_ED2208_ENABLED
	select MIPI_DBI
	help
	  Enable driver for ED2208 compatible controller.
```

## dts/bindings/display/waveshare,ed2208.yaml
```yaml
# Copyright (c) 2021 Nordic Semiconductor ASA
# SPDX-License-Identifier: Apache-2.0

description: Waveshare ED2208 800x480 color e-paper display controller

compatible: "waveshare,ed2208"

include: [mipi-dbi-spi-device.yaml, display-controller.yaml]

properties:
  busy-gpios:
    type: phandle-array
    required: true
    description: BUSY pin.

      The BUSY pin of ED2208 is active low.
      If connected directly the MCU pin should be configured
      as active low.
```
